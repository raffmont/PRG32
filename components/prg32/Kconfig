## components/prg32/Kconfig
```kconfig
menu "PRG32 framework"

choice PRG32_DISPLAY_BACKEND
    prompt "Display backend"
    default PRG32_DISPLAY_ILI9341
    help
        Select the display implementation used by the PRG32 graphics ABI.
        The ILI9341 backend is for the physical ESP32-C6 classroom board. The
        QEMU RGB backend is for desktop screen testing with Espressif's
        ESP32-C3 RISC-V QEMU target and idf.py qemu --graphics.

config PRG32_DISPLAY_ILI9341
    bool "ILI9341 SPI TFT"
    help
        Use the reference ILI9341 320x240 SPI TFT display connected to the
        ESP32-C6 pins configured in main/prg32_config.h.

config PRG32_DISPLAY_QEMU_RGB
    bool "QEMU virtual RGB panel"
    depends on IDF_TARGET_ESP32C3
    help
        Use Espressif QEMU's virtual RGB framebuffer. Run with:
        idf.py qemu --graphics monitor

endchoice

config PRG32_QEMU_FAIL_ON_REAL_HW
    bool "Fail fast when QEMU backend is run on real hardware"
    depends on PRG32_DISPLAY_QEMU_RGB
    default y
    help
        The QEMU RGB backend is not available on physical ESP32 boards.
        Keep this enabled so accidental real-hardware flashes stop clearly
        during display initialization instead of silently losing graphics.

config PRG32_SPLASH_ENABLED
    bool "Show PRG32 startup splash"
    default y
    help
        Draw the PRG32 splash screen when the resident firmware starts.

config PRG32_SPLASH_DURATION_MS
    int "Startup splash duration in milliseconds"
    depends on PRG32_SPLASH_ENABLED
    default 900
    range 0 5000
    help
        How long the firmware startup splash remains visible before runtime
        initialization continues.

config PRG32_SPLASH_SOUND_ENABLED
    bool "Play welcome sound during startup splash"
    depends on PRG32_SPLASH_ENABLED
    default y
    help
        When the PRG32 I2S audio subsystem is enabled, initialize it and play a
        short welcome tone sequence while the firmware splash is visible.

endmenu
```

## sdkconfig.defaults
```kconfig
CONFIG_PARTITION_TABLE_CUSTOM=y
CONFIG_PARTITION_TABLE_CUSTOM_FILENAME="partitions_prg32.csv"
CONFIG_ESPTOOLPY_FLASHSIZE_4MB=y
CONFIG_ESPTOOLPY_FLASHSIZE="4MB"
CONFIG_ESP_CONSOLE_UART_DEFAULT=y
# CONFIG_ESP_CONSOLE_USB_SERIAL_JTAG is not set
CONFIG_ESP_CONSOLE_SECONDARY_USB_SERIAL_JTAG=y
# CONFIG_ESP_CONSOLE_SECONDARY_NONE is not set
CONFIG_PRG32_DISPLAY_ILI9341=y
CONFIG_PRG32_AUDIO_ENABLED=y
CONFIG_PRG32_AUDIO_SAMPLE_RATE=22050
CONFIG_PRG32_AUDIO_MODE_MONO=y
CONFIG_PRG32_AUDIO_MAX_VOICES=6
CONFIG_PRG32_AUDIO_I2S_BCLK_GPIO=4
CONFIG_PRG32_AUDIO_I2S_LRCLK_GPIO=5
CONFIG_PRG32_AUDIO_I2S_DATA_GPIO=6
CONFIG_PRG32_AUDIO_I2S_SD_GPIO=7
CONFIG_PRG32_SPLASH_ENABLED=y
CONFIG_PRG32_SPLASH_DURATION_MS=900
CONFIG_PRG32_SPLASH_SOUND_ENABLED=y
```

## sdkconfig.defaults.qemu
```kconfig
# Use with: idf.py -B build-qemu -D SDKCONFIG_DEFAULTS=sdkconfig.defaults.qemu set-target esp32c3
CONFIG_PARTITION_TABLE_CUSTOM=y
CONFIG_PARTITION_TABLE_CUSTOM_FILENAME="partitions_prg32.csv"
CONFIG_PRG32_DISPLAY_QEMU_RGB=y
CONFIG_PRG32_QEMU_FAIL_ON_REAL_HW=y
CONFIG_ESPTOOLPY_FLASHSIZE_4MB=y
CONFIG_PRG32_AUDIO_ENABLED=y
CONFIG_PRG32_AUDIO_SAMPLE_RATE=22050
CONFIG_PRG32_AUDIO_MODE_MONO=y
CONFIG_PRG32_AUDIO_MAX_VOICES=6
CONFIG_PRG32_SPLASH_ENABLED=y
CONFIG_PRG32_SPLASH_DURATION_MS=900
CONFIG_PRG32_SPLASH_SOUND_ENABLED=y
```
